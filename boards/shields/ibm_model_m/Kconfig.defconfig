## boards/shields/ibm_model_m/Kconfig.defconfig
```kconfig
if SHIELD_IBM_MODEL_M

config ZMK_KEYBOARD_NAME
    default "IBM Model M"

config SPI
    default y

config ZMK_KSCAN_MATRIX_POLLING
    default y

endif
```
